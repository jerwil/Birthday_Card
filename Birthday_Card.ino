//********************************************************
// Output of Miduino v1.1
// Tailored for the 3 timers in jerwil's Arduino Uno
//********************************************************
// Miditones / Playtune conversion suite by Len Shustek
// Miduino web interfaces and hosting by Connor Nishijima
//********************************************************

#include <Playtune.h>
int button_pin = 10;
char* mode = "wait";

int button_press_initiate[1]; 
int button_press_completed[1];
int button_pushed = 0; // This is the indicator that the button was pushed and released
int button_indicator = 0;



//------------------------------------------------
//   scores are put in program space memory
//------------------------------------------------


byte PROGMEM score [] = {
// Wind Scene
0x91,74, 2,154, 0x81, 0x91,76, 2,154, 0x92,62, 0,33, 0x81, 
0x91,77, 1,44, 0x82, 0x92,65, 0,33, 0x81, 0x91,76, 1,44, 0x82, 0x92,76, 0,33, 0x81, 0x82, 
0x91,72, 1,77, 0x81, 0x91,69, 1,44, 0x92,58, 0,33, 0x81, 0x91,74, 1,44, 0x82, 0x92,65, 
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0x82, 0x92,76, 1,77, 2,154, 1,77, 1,77, 2,154, 1,77, 5,53, 0x81, 0x82, 0xf0};
// This score contains 1364 bytes, and 3 tone generators are used.
// 69 notes had to be skipped.


Playtune pt;

void setup() {

  pt.tune_initchan (11); // Enable all 3 ATMega328/164 timers for notes that are output on digital pins 2, 3, and 4.
  pt.tune_initchan (5); // Those pins should be wired to 500-ohm resistors, the other ends of which should be connected together
  pt.tune_initchan (6); // Those pins should be wired to 500-ohm resistors, the other ends of which should be connected together


pinMode(button_pin,INPUT);

}

int button_press (int button_indicator, int button_press_initiated[1], int button_press_complete[1]){
	if (button_indicator == 0 && button_press_initiated[0] == 1) {
	button_press_complete[0] = 1;
	button_press_initiated[0] = 0;
	}
	else if (button_indicator == 1){
	button_press_initiated[0] = 1;
	button_press_complete[0] = 0;
	}
	else {button_press_complete[0] = 0;}
return button_press_complete[0];
}

void loop () {
  

  button_indicator = digitalRead(button_pin);
  button_pushed = button_press (button_indicator, button_press_initiate, button_press_completed);
if (mode == "play"){
    pt.tune_playscore (score); /* start playing */
    while (pt.tune_playing){
      button_indicator = digitalRead(button_pin);
      button_pushed = button_press (button_indicator, button_press_initiate, button_press_completed);
      if (button_pushed == 1){
      pt.tune_stopscore();
      mode = "wait";
      }
    } ;   /* wait here until playing stops */
    mode = "wait";
  }
  else if (mode == "wait"){
    if (button_pushed == 1){
      mode = "play";
      button_pushed = 0;
    }
  }
}

//*************************************
// Thank you for using Miduino!
// - Connor Nishijima and Len Shustek
//*************************************
